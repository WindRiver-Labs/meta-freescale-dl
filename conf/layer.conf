## conf/layer.conf
```bitbake
#
# Copyright (C) 2020 Wind River Systems, Inc.
#
BBFILE_COLLECTIONS += "meta-freescale-dl"
BBFILE_PATTERN_meta-freescale-dl = ""
BBFILE_PATTERN_IGNORE_EMPTY_meta-freescale-dl = "1"
# This should only be incremented on significant changes that will
# cause compatibility issues with other layers
LAYERVERSION_meta-freescale-dl = "1"
LAYERSERIES_COMPAT_meta-freescale-dl = "thud zeus"

# We have a pre-populated downloads directory, add to PREMIRRORS
PREMIRRORS_append = " \
     .*://.*/.* file://${LAYERDIR}/downloads/ \n \
     git://.*/.* git://${LAYERDIR}/git/MIRRORNAME;protocol=file \n \
"
```
